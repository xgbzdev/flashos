## configs/flashos_defconfig
```kconfig
# FlashOS - tiny x86_64 Linux that boots straight into the FlashOS shell
BR2_x86_64=y
BR2_TOOLCHAIN_BUILDROOT_GLIBC=y
BR2_TOOLCHAIN_BUILDROOT_CXX=y

# System
BR2_TARGET_GENERIC_HOSTNAME="flashos"
BR2_TARGET_GENERIC_ISSUE="FlashOS"
BR2_ROOTFS_DEVICE_CREATION_DYNAMIC_EUDEV=y
# BR2_TARGET_GENERIC_GETTY is not set
BR2_ROOTFS_OVERLAY="$(BR2_EXTERNAL_FLASHOS_PATH)/board/flashos/rootfs-overlay"
BR2_ROOTFS_POST_BUILD_SCRIPT="$(BR2_EXTERNAL_FLASHOS_PATH)/board/flashos/post-build.sh"

# Kernel
BR2_LINUX_KERNEL=y
BR2_LINUX_KERNEL_LATEST_VERSION=y
BR2_LINUX_KERNEL_USE_ARCH_DEFAULT_CONFIG=y
BR2_LINUX_KERNEL_CONFIG_FRAGMENT_FILES="$(BR2_EXTERNAL_FLASHOS_PATH)/board/flashos/linux.fragment"
BR2_LINUX_KERNEL_NEEDS_HOST_LIBELF=y

# Sound
BR2_PACKAGE_ALSA_LIB=y

# Graphics: minimal Xorg on the framebuffer + Mesa software GL (for Ruffle)
BR2_PACKAGE_MESA3D=y
BR2_PACKAGE_MESA3D_GALLIUM_DRIVER_SWRAST=y
BR2_PACKAGE_MESA3D_OPENGL_GLX=y
BR2_PACKAGE_MESA3D_OPENGL_EGL=y
BR2_PACKAGE_MESA3D_OPENGL_ES=y
BR2_PACKAGE_XORG7=y
BR2_PACKAGE_XSERVER_XORG_SERVER=y
BR2_PACKAGE_XSERVER_XORG_SERVER_MODULAR=y
BR2_PACKAGE_XDRIVER_XF86_INPUT_LIBINPUT=y
BR2_PACKAGE_XDRIVER_XF86_VIDEO_FBDEV=y
BR2_PACKAGE_XLIB_LIBX11=y
BR2_PACKAGE_XLIB_LIBXCURSOR=y
BR2_PACKAGE_XLIB_LIBXEXT=y
BR2_PACKAGE_XLIB_LIBXI=y
BR2_PACKAGE_XLIB_LIBXRANDR=y
BR2_PACKAGE_XLIB_LIBXRENDER=y
BR2_PACKAGE_LIBXKBCOMMON=y
BR2_PACKAGE_XKEYBOARD_CONFIG=y
BR2_PACKAGE_XAPP_XKBCOMP=y
BR2_PACKAGE_FONTCONFIG=y
BR2_PACKAGE_DEJAVU=y

# Ruffle runtime deps
BR2_PACKAGE_OPENSSL=y
BR2_PACKAGE_ZLIB=y

# FlashOS
BR2_PACKAGE_FLASHOS_TOOLS=y

# Images: bzImage + initramfs packed into a bootable hybrid ISO (CD or USB)
BR2_TARGET_ROOTFS_CPIO=y
BR2_TARGET_ROOTFS_CPIO_GZIP=y
BR2_TARGET_ROOTFS_ISO9660=y
BR2_TARGET_ROOTFS_ISO9660_ISOLINUX=y
BR2_TARGET_ROOTFS_ISO9660_BOOT_MENU="$(BR2_EXTERNAL_FLASHOS_PATH)/board/flashos/isolinux.cfg"
BR2_TARGET_ROOTFS_ISO9660_INITRD=y
BR2_TARGET_ROOTFS_ISO9660_HYBRID=y
# BR2_TARGET_ROOTFS_TAR is not set
BR2_TARGET_SYSLINUX=y
BR2_TARGET_SYSLINUX_ISOLINUX=y
```

## package/flashos-tools/Config.in
```kconfig
config BR2_PACKAGE_FLASHOS_TOOLS
	bool "flashos-tools"
	depends on BR2_PACKAGE_XORG7
	select BR2_PACKAGE_XLIB_LIBX11
	help
	  FlashOS shell (flashsh) and fullscreen window manager (flashwm).
```
